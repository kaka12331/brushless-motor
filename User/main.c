/**
  ******************************************************************************
  * @file    main.c
  * @brief   无刷电机双机“平滑往返”演示程序（电赛备赛）
  * @details
  *   硬件平台：STM32F103C8（标准外设库）
  *   功能概述：
  *     1. 初始化 OLED，显示调试信息
  *     2. 初始化两路无刷电机串口通信（USART2, 115200）
  *     3. 依次：使能 -> 设模式(T型多圈位置) -> 设加速度 -> 设速度
  *     4. 主循环中周期性：
  *        - 让两台电机在 0 与 18000 两个目标位置之间切换
  *        - 请求位置反馈，并在 OLED 上显示实时位置
  *
  *   时间粗算（与循环内 Delay 有关）：
  *     偶数拍：Req M1 + 10ms + Req M2 + 10ms ≈ 20ms + 通信时间
  *     奇数拍：Delay 20ms
  *     time_count 每圈 +1，到 150 切换一次目标
  *     => 切换周期大约 150 * 20ms ≈ 3s 量级（实际略长，因串口阻塞发送）
  *     原注释按约 7s 估算时，已考虑加速度较软、到位需要更长时间。
  *
  *   使用前检查：
  *     - 电机 ID 是否与 Motor1/Motor2 一致
  *     - 串口 TX/RX 是否交叉连接且共地
  *     - 位置单位 18000 是否在你的电机量程/减速比下合理（需实机标定）
  ******************************************************************************
  */

#include "stm32f10x.h"
#include "bldc_motor.h"
#include "Delay.h"
#include "OLED.h"

/**
  * @brief  主函数：初始化 + 双电机平滑往返 + OLED 显示
  * @retval 不返回
  */
int main(void)
{
    /* 主循环节拍计数：用于控制“换向周期”和“反馈刷新节奏” */
    uint32_t time_count = 0;

    /* 目标位置：在 0 与 18000 之间来回切换
     * 注意：18000 是驱动器内部位置单位，不是角度本身。
     * 若电机不动或转角过大/过小，优先改这个数做标定。
     */
    int target_position = 18000;

    /* ===================== 外设初始化 ===================== */
    OLED_Init();
    OLED_ShowString(1, 1, "Smooth Test...");   /* 上电提示：正在做平滑运动测试 */

    /* 电机通信：USART2 + DMA 接收，波特率 115200 */
    BLDC_Init(115200);
    Delay_ms(1000);   /* 等待驱动器上电稳定，避免立刻发指令丢帧 */

    /* ===================== 第1步：集体使能 =====================
     * 失能状态下设速度/位置可能无效。
     * 两台电机之间留 50ms，减轻总线突发占用。
     * ========================================================== */
    BLDC_Enable(Motor1.ID);
    Delay_ms(50);
    BLDC_Enable(Motor2.ID);
    Delay_ms(50);

    /* ===================== 第2步：设置模式 =====================
     * 0x0001 = 多圈位置模式 + T 型轨迹规划（见 MOTOR_MODE_POS_MULTI_T）
     * 特点：运动过程有加减速，启停比“直接位置模式”更柔和。
     * ========================================================== */
    BLDC_Set_Mode(Motor1.ID, 0x0001);
    Delay_ms(50);
    BLDC_Set_Mode(Motor2.ID, 0x0001);
    Delay_ms(50);

    /* ===================== 第3步：设置加速度 =====================
     * 单位以驱动器手册为准（常见为 转/s² 或内部加速度单位）。
     * 此处设为 50：起步很软；若觉得太慢可加大（如 100~200），
     * 若仍冲击明显可减小（如 20~30）。
     * 配合 T 型轨迹时，加速度会限制“从 0 加速到设定速度”的斜率。
     * ============================================================ */
    BLDC_Set_Acceleration(Motor1.ID, 50);
    Delay_ms(50);
    BLDC_Set_Acceleration(Motor2.ID, 50);
    Delay_ms(50);

    /* ===================== 第4步：设置速度 =====================
     * 位置模式下通常表示“运动过程的最大/规划速度”。
     * 40 为偏保守的速度；想更快可增大，但要给 time_count 阈值留足到位时间。
     * ========================================================== */
    BLDC_Set_Speed(Motor1.ID, 40);
    Delay_ms(50);
    BLDC_Set_Speed(Motor2.ID, 40);
    Delay_ms(50);

    /* OLED 固定标签：第 1/3 行标题，第 2/4 行滚动刷新数值 */
    OLED_Clear();
    OLED_ShowString(1, 1, "M1 Pos:");
    OLED_ShowString(3, 1, "M2 Pos:");

    /* ===================== 主循环 ===================== */
    while (1) {
        time_count++;

        /* ---------- 周期性切换目标位置 ----------
         * time_count 累加到 150 后清零，并下发新的目标位置。
         * 切换太快：电机还没到位又改目标，轨迹会来回“抢”。
         * 加速度设得很软时，应适当增大阈值阈值（150 可再调大）。
         * -------------------------------------------- */
        if (time_count >= 150) {
            time_count = 0;

            /* 两台电机同步跟踪同一个目标，实现“齐步往返” */
            BLDC_Set_Position(Motor1.ID, target_position);
            Delay_ms(20);

            BLDC_Set_Position(Motor2.ID, target_position);
            Delay_ms(20);

            /* 在 18000 <-> 0 之间翻转目标 */
            if (target_position == 18000) {
                target_position = 0;
            } else {
                target_position = 18000;
            }
        }

        /* ---------- 位置反馈 + OLED 刷新 ----------
         * 仅在偶数拍请求反馈，降低总线占用，给电机驱动器处理时间。
         * 奇数拍补 20ms 延时，使主循环节拍大致均匀。
         * 反馈解析在 USART2_IRQHandler 中完成，这里只读结构体。
         * -------------------------------------------- */
        if (time_count % 2 == 0) {
            BLDC_Req_Feedback(Motor1.ID);
            Delay_ms(10);
            BLDC_Req_Feedback(Motor2.ID);
            Delay_ms(10);

            /* 显示 6 位有符号位置（不足补空格/由 OLED 驱动处理） */
            OLED_ShowSignedNum(2, 1, Motor1.Current_Position, 6);
            OLED_ShowSignedNum(4, 1, Motor2.Current_Position, 6);
        } else {
            Delay_ms(20);   /* 与偶数拍总延时对齐，避免节奏忽快忽慢 */
        }
    }
}
